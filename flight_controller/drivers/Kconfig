## flight_controller/drivers/Kconfig
```kconfig
# Out-of-tree drivers root
menu "Out-of-tree drivers"
rsource "sensor/Kconfig"
endmenu
```

## flight_controller/drivers/sensor/Kconfig
```kconfig
# Copyright (c) 2025
# SPDX-License-Identifier: Apache-2.0

menu "Out-of-tree sensor drivers"
rsource "lidar_lite_v4/Kconfig"
endmenu
```

## flight_controller/drivers/sensor/lidar_lite_v4/Kconfig
```kconfig
# Copyright (c) 2021 Nordic Semiconductor ASA
# SPDX-License-Identifier: Apache-2.0


config LIDAR_LITE_V4
	bool "Lidar Lite V4 support"
	depends on I2C
	default y
	help
	  Driver for Lidar Lite V4 I2C Operation.
```

## test_node/modules/spis_bitbang/drivers/spis_bitbang/Kconfig
```kconfig
# ESP32 SPI configuration

# Copyright (c) 2020 Espressif Systems (Shanghai) Co., Ltd.
# SPDX-License-Identifier: Apache-2.0

config SPIS_BITBANG
	bool "Bitbang SPI Slave controller driver"
	default n
	depends on GPIO # dependent on GPIO driver
	help
	  Enable the Bitbang SPI Slave controller
```
