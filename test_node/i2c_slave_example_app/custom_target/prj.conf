## CMakeLists.txt
```
# SPDX-License-Identifier: Apache-2.0

cmake_minimum_required(VERSION 3.20.0)

set(ZEPHYR_EXTRA_MODULES "${CMAKE_SOURCE_DIR}/../../modules/i2c_bitbang")

find_package(Zephyr REQUIRED HINTS $ENV{ZEPHYR_BASE})
project(i2c_custom_target)

target_sources(app PRIVATE src/main.c)
```

## prj.conf
```kconfig
CONFIG_I2C=y
CONFIG_I2C_TARGET=y
CONFIG_LOG=y
CONFIG_LOG_MAX_LEVEL=4
CONFIG_LOG_DEFAULT_LEVEL=4
CONFIG_LOG_MODE_IMMEDIATE=y
CONFIG_I2C_GPIO=y
```

## boards/esp32s3_devkitc.overlay
```dts
/ {
	i2cbb0: i2cbb0 {
		compatible = "zephyr,i2c-bitbang";
		status = "okay";
		#address-cells = <1>;
		#size-cells = <0>;
		clock-frequency = <I2C_BITRATE_STANDARD>;

		sda-gpios = <&gpio0 15 (GPIO_OPEN_DRAIN | GPIO_ACTIVE_HIGH)>;
		scl-gpios = <&gpio0 16 (GPIO_OPEN_DRAIN | GPIO_ACTIVE_HIGH)>;
	};
};
```

## src/main.c
```c
/*
 * Copyright (c) 2024 Open Pixel Systems
 *
 * SPDX-License-Identifier: Apache-2.0
 */

#include <zephyr/kernel.h>
#include <zephyr/sys/printk.h>
#include <zephyr/drivers/i2c.h>

static const struct device *i2c0 = DEVICE_DT_GET(DT_NODELABEL(i2cbb0));
static char last_byte;

/*
 * @brief Callback which is called when a write request is received from the master.
 * @param config Pointer to the target configuration.
 */
int sample_target_write_requested_cb(struct i2c_target_config *config)
{
	printk("\nsample target write requested\n");
	return 0;
}

/*
 * @brief Callback which is called when a write is received from the master.
 * @param config Pointer to the target configuration.
 * @param val The byte received from the master.
 */
int sample_target_write_received_cb(struct i2c_target_config *config, uint8_t val)
{
	printk("\nsample target write received: 0x%02x\n", val);
	last_byte = val;
	return 0;
}

/*
 * @brief Callback which is called when a read request is received from the master.
 * @param config Pointer to the target configuration.
 * @param val Pointer to the byte to be sent to the master.
 */
int sample_target_read_requested_cb(struct i2c_target_config *config, uint8_t *val)
{
	printk("\nsample target read request: 0x%02x\n", *val);
	*val = 0x42;
	return 0;
}

/*
 * @brief Callback which is called when a read is processed from the master.
 * @param config Pointer to the target configuration.
 * @param val Pointer to the next byte to be sent to the master.
 */
int sample_target_read_processed_cb(struct i2c_target_config *config, uint8_t *val)
{
	printk("\nsample target read processed: 0x%02x\n", *val);
	*val = 0x43;
	return 0;
}

/*
 * @brief Callback which is called when the master sends a stop condition.
 * @param config Pointer to the target configuration.
 */
int sample_target_stop_cb(struct i2c_target_config *config)
{
	printk("\nsample target stop callback\n");
	return 0;
}

static struct i2c_target_callbacks sample_target_callbacks = {
	.write_requested = sample_target_write_requested_cb,
	.write_received = sample_target_write_received_cb,
	.read_requested = sample_target_read_requested_cb,
	.read_processed = sample_target_read_processed_cb,
	.stop = sample_target_stop_cb,
};

static struct i2c_target_config target_cfg = {
	.address = 0x60,
	.callbacks = &sample_target_callbacks,
};

int main(void)
{
	

	printk("i2c custom target sample\n");

	if (i2c_target_register(i2c0, &target_cfg) != 0) {
		printk("Failed to register target\n");
		return -1;
	}

	return 0;
}
```
