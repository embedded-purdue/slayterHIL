## prj.conf
```kconfig
CONFIG_I2C=y
CONFIG_I2C_TARGET=y
CONFIG_LOG=y
CONFIG_LOG_MAX_LEVEL=4
CONFIG_LOG_DEFAULT_LEVEL=4
CONFIG_LOG_MODE_IMMEDIATE=y
```

## boards/esp32s3_devkitc.overlay
```dts
&pinctrl {
	// custom pin settings for i2c bus 0
	i2c0_controller_pins: i2c0_controller_pins {
		group1 {
			pinmux = <I2C0_SDA_GPIO15>, <I2C0_SCL_GPIO16>; // SDA on GPIO15, SCL on GPIO16
			bias-pull-up; // enable pull-up resistors for both pins
			drive-open-drain; // required for i2c
			// output-high; // start with lines high
		};
	};
};

// enable i2c
&i2c0 {
	pinctrl-0 = <&i2c0_controller_pins>;
	status = "okay";
};
```

## src/main.c
```c
/*
 * Copyright (c) 2024 Open Pixel Systems
 *
 * SPDX-License-Identifier: Apache-2.0
 */

#include <zephyr/kernel.h>
#include <zephyr/sys/printk.h>
#include <zephyr/drivers/i2c.h>

static const struct device *i2c1 = DEVICE_DT_GET(DT_NODELABEL(i2c1));
static char last_byte;

/*
 * @brief Callback which is called when a write request is received from the master.
 * @param config Pointer to the target configuration.
 */
int sample_target_write_requested_cb(struct i2c_target_config *config)
{
	printk("\nsample target write requested\n");
	return 0;
}

/*
 * @brief Callback which is called when a write is received from the master.
 * @param config Pointer to the target configuration.
 * @param val The byte received from the master.
 */
int sample_target_write_received_cb(struct i2c_target_config *config, uint8_t val)
{
	printk("\nsample target write received: 0x%02x\n", val);
	last_byte = val;
	return 0;
}

/*
 * @brief Callback which is called when a read request is received from the master.
 * @param config Pointer to the target configuration.
 * @param val Pointer to the byte to be sent to the master.
 */
int sample_target_read_requested_cb(struct i2c_target_config *config, uint8_t *val)
{
	printk("\nsample target read request: 0x%02x\n", *val);
	*val = 0x42;
	return 0;
}

/*
 * @brief Callback which is called when a read is processed from the master.
 * @param config Pointer to the target configuration.
 * @param val Pointer to the next byte to be sent to the master.
 */
int sample_target_read_processed_cb(struct i2c_target_config *config, uint8_t *val)
{
	printk("\nsample target read processed: 0x%02x\n", *val);
	*val = 0x43;
	return 0;
}

/*
 * @brief Callback which is called when the master sends a stop condition.
 * @param config Pointer to the target configuration.
 */
int sample_target_stop_cb(struct i2c_target_config *config)
{
	printk("\nsample target stop callback\n");
	return 0;
}

static struct i2c_target_callbacks sample_target_callbacks = {
	.write_requested = sample_target_write_requested_cb,
	.write_received = sample_target_write_received_cb,
	.read_requested = sample_target_read_requested_cb,
	.read_processed = sample_target_read_processed_cb,
	.stop = sample_target_stop_cb,
};

struct i2c_target_config target_cfg = {
	.address = 0x60,
	.callbacks = &sample_target_callbacks,
};

int main(void)
{
	printk("i2c custom target sample\n");

	if (i2c_target_register(i2c1, &target_cfg) != 0) {
		printk("Failed to register target\n");
		return -1;
	}

	return 0;
}
```
