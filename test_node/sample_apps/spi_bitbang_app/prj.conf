## CMakeLists.txt
```
#-------------------------------------------------------------------------------
# Zephyr Example Application
#
# Copyright (c) 2021 Nordic Semiconductor ASA
# SPDX-License-Identifier: Apache-2.0

cmake_minimum_required(VERSION 3.20.0)

set(ZEPHYR_EXTRA_MODULES "${CMAKE_SOURCE_DIR}/../../modules/spis_bitbang")

find_package(Zephyr REQUIRED HINTS $ENV{ZEPHYR_BASE})
project(spi_bitbang_app)

project(app LANGUAGES C)

target_sources(app PRIVATE src/main.c)
```

## prj.conf
```kconfig
CONFIG_STDOUT_CONSOLE=y
CONFIG_SPI=y
CONFIG_SPI_SLAVE=y
CONFIG_SPIS_BITBANG=y
```

## boards/spi_esp32s3_devkitc.overlay
```dts
/* note that these shouldn't be 10-13 given that the spi module uses them and enables itself */
/ {
	spibb0: spibb0 {
		compatible = "zephyr,spis-bitbang";
		status = "okay";
		#address-cells = <1>;
		#size-cells = <0>;
		cs-gpios = <&gpio0 16 (GPIO_ACTIVE_LOW | GPIO_PULL_DOWN)>;
		mosi-gpios = <&gpio0 17 GPIO_ACTIVE_HIGH>;
		clk-gpios = <&gpio0 18 GPIO_ACTIVE_HIGH>;
		miso-gpios = <&gpio0 8 0>;
	};
};
```

## src/main.c
```c
#include <zephyr/devicetree.h>
#include <zephyr/drivers/spi.h>

#define LEN_TRANSCEIVE 12
#define SPIBB_NODE	DT_NODELABEL(spibb0)

int main(void)
{
	printk("hello world!");
	const struct device *const dev = DEVICE_DT_GET(SPIBB_NODE);

	struct spi_config config;
	config.operation = SPI_OP_MODE_SLAVE | SPI_WORD_SET(8);

	if (!device_is_ready(dev)) {
		printk("%s: device not ready.\n", dev->name);
		return 0;
	}

    // read
    uint8_t read_buf[LEN_TRANSCEIVE] = {0};
    struct spi_buf spi_read_buf = {&read_buf, LEN_TRANSCEIVE};
    const struct spi_buf_set rx_buf = {&spi_read_buf, 1};

    // write
    uint8_t write_buf[LEN_TRANSCEIVE] = {0};
    struct spi_buf spi_write_buf = {&write_buf, LEN_TRANSCEIVE};
    const struct spi_buf_set tx_buf = {&spi_write_buf, 1};

	// populate the write buffer
    for (int i = 0; i < LEN_TRANSCEIVE; i++) write_buf[i] = i + 4;

    // transceive
	printk("Transceiving\n");
    int transceive_res = spi_transceive(dev, &config, &tx_buf, &rx_buf);

	// transceive result should be 0 (if master, which we are) upon end.
    if (transceive_res)
    {
        printk("Error on transcceiving\n");
        return 1;
    }

	// print out what has been read
    for (int i = 0; i < LEN_TRANSCEIVE; i++) printk("received word %d: %d\n", i, read_buf[i]);

	return 0;
}
```
