## CMakeLists.txt
```
#-------------------------------------------------------------------------------
# Zephyr Example Application
#
# Copyright (c) 2021 Nordic Semiconductor ASA
# SPDX-License-Identifier: Apache-2.0

cmake_minimum_required(VERSION 3.20.0)

set(ZEPHYR_EXTRA_MODULES "${CMAKE_SOURCE_DIR}/../modules/spis_bitbang")

find_package(Zephyr REQUIRED HINTS $ENV{ZEPHYR_BASE})
project(spi_bitbang_app)

project(app LANGUAGES C)

target_sources(app PRIVATE src/main.c)
```

## prj.conf
```kconfig
CONFIG_STDOUT_CONSOLE=y
CONFIG_SPI=y
CONFIG_SPI_SLAVE=y
CONFIG_SPIS_BITBANG=y


CONFIG_LOG=y
CONFIG_LOG_DEFAULT_LEVEL=4
CONFIG_LOG_BACKEND_UART=y
```

## boards/nucleo_h563zi.overlay
```dts
/* 
 * Avoid pins used by SPI1 (PA5, PG9, PB5, PD14), USART (PD8-9, PB6-7),
 * I2C1 (PB8-9), Ethernet, LEDs (PB0, PF4, PG4), etc.
 *
 * Selected pins on GPIOE (accessible on ST Morpho connector):
 *   CS   = PE2
 *   MOSI = PE3
 *   CLK  = PE4
 *   MISO = PE5
 */

/ {
	spibb0: spibb0 {
		compatible = "zephyr,spis-bitbang";
		status = "okay";
		#address-cells = <1>;
		#size-cells = <0>;
		cs-gpios   = <&gpioe 2 (GPIO_ACTIVE_LOW | GPIO_PULL_DOWN)>;
		mosi-gpios = <&gpioe 3 GPIO_ACTIVE_HIGH>;
		clk-gpios  = <&gpioe 4 GPIO_ACTIVE_HIGH>;
		miso-gpios = <&gpioe 5 0>;
	};
};
```

## src/main.c
```c
#include <zephyr/devicetree.h>
#include <zephyr/drivers/spi.h>

#define LEN_TRANSCEIVE 4
#define SPIBB_NODE	DT_NODELABEL(spibb0)

int main(void)
{
	printk("hello world!");
	const struct device *const dev = DEVICE_DT_GET(SPIBB_NODE);

	struct spi_config config;
	config.operation = SPI_OP_MODE_SLAVE | SPI_WORD_SET(8);

	if (!device_is_ready(dev)) {
		printk("%s: device not ready.\n", dev->name);
		return 0;
	}

    // read
    uint8_t read_buf[LEN_TRANSCEIVE] = {0};
    struct spi_buf spi_read_buf = {&read_buf, LEN_TRANSCEIVE};
    const struct spi_buf_set rx_buf = {&spi_read_buf, 1};

    // write
    uint8_t write_buf[LEN_TRANSCEIVE] = {0};
    struct spi_buf spi_write_buf = {&write_buf, LEN_TRANSCEIVE};
    const struct spi_buf_set tx_buf = {&spi_write_buf, 1};

	// populate the write buffer
    for (int i = 0; i < LEN_TRANSCEIVE; i++) write_buf[i] = i + 4;

    // transceive
	printk("Transceiving\n");
    int transceive_res = spi_transceive(dev, &config, &tx_buf, &rx_buf);

	// transceive result should be 0 (if master, which we are) upon end.
    if (transceive_res)
    {
        printk("Error on transcceiving\n");
        return 1;
    }

	// print out what has been read
    for (int i = 0; i < LEN_TRANSCEIVE; i++) printk("received word %d: %d\n", i, read_buf[i]);

	return 0;
}
```
